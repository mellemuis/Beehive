/*!
 \file payloadencoder.h
 \brief payloadencoder class
 \author Michelle Udo (m.udo@student.han.nl)
 \date See version table
 \version see version table

 # Version history

 Version|Date        |Note
 -------|------------|-----------------
 0.1    | 3-3-2020   | Initial version
 1.0    | 04-02-2023 | Arduino code TTN
 *  
 *  Payload 1
 *  payloadIdentifier {1},
    battery {0},
    beeactivitySensor {0},
    honey {0},

    Payload 2
    payloadIdentifier {2},
    latitude {0},
    longitude {0},
    position
    beeAlarm
    
 * 
 */

 

#include "TheThingsNetwork_HANIoT.h"
#include "HAN_IoT_Shield.h"
#include "PE1MEW_Timer.h"
#include "payloadencoder.h"

// Configure TTN
// =============

// Set your DevEUI, AppEUI and AppKey
const char *devEui = "0004A30B00204775";                  ///< devEUI to be generated by TTN Console
const char *appEui = "01507C8B01507C8C";                  ///< appEUI retrieve from TTN Console application
const char *appKey = "DA86377607DA4DCB0DEAFBA6C7C412BD";  ///< appKEY rtrieve from TTN Console application

#define loraSerial Serial1
#define debugSerial Serial

// Replace REPLACE_ME with TTN_FP_EU868 or TTN_FP_US915
#define freqPlan TTN_FP_EU868

TheThingsNetwork_HANIoT ttn(loraSerial, debugSerial, freqPlan);

// Configure HAN IoT Shield
// =========================
iotShieldPotmeter potmeter1(PIN_POT_RED, -20, 500);
iotShieldPotmeter potmeter2(PIN_POT_WHITE, 0, 100);

iotShieldButton redButton(PIN_SWITCH_RED);
iotShieldButton blackButton(PIN_SWITCH_BLACK);

iotShieldLED leftRedLED(PIN_LED_1_RED);
iotShieldLED rightRedLED(PIN_LED_2_RED);
iotShieldLED leftGreenLED(PIN_LED_3_GRN);
iotShieldLED rightGreenLED(PIN_LED_4_GRN);

iotShieldTempSensor temperatureSensor;

  uint8_t payloadIdentifier = 0;
  uint8_t battery = 0;
  uint8_t beeactivitySensor = 0;
  uint8_t honey = 0;

  //Flags messages
  bool m_message = true;                    
  bool a_message = false;
  
  int currentMillis;
  int startMillis;
  int period = 5000;

void setup()
{
  ttn.onMessage(messageReceived);
  loraSerial.begin(57600);
  debugSerial.begin(9600);
  startMillis = millis();

  // Wait a maximum of 10s for Serial Monitor
  while (!debugSerial && millis() < 10000)
    ;

  // Send "Hello world" on leds
  helloWorld();

  debugSerial.println(F("-- STATUS"));
  ttn.showStatus();

  debugSerial.println(F("-- JOIN"));
  ttn.join(devEui, appEui, appKey);
}

void loop()
{
 currentMillis = millis();
 
  
 if(beeactivitySensor >= 110)
  {
  a_message = true;
  m_message = false;
  }
  
  debugSerial.println("-- LOOP");
  //Read values for payload
     
   debugSerial.println("loop millis");
    if(m_message)
    {
      sendmainMessage();
     debugSerial.println("send main message");
    }
  
    if(a_message)
    {
      sendAlarmMessage();
      debugSerial.println("send alarm message");
    }
      
  amountHoney();

  delay(5000);
}

void messageReceived(const uint8_t *payload, size_t size, port_t port)
{
  leftGreenLED.setState(LED_ON);
  debugSerial.println(F("-- MESSAGE"));
  debugSerial.print("Received " + String(size) + " bytes on port " + String(port) + ": ");
}

void sendmainMessage(void)
{
  myPayloadEncoder encoder;   ///< Encoder object
  payloadIdentifier = 1;
  battery = map(analogRead(PIN_POT_WHITE), 1023, 0, 0, 100);
  beeactivitySensor = map(analogRead(PIN_POT_RED),1023,0,70,120);
  
  encoder.setPayloadIdentifier(payloadIdentifier);
  encoder.setBattery(battery);
  encoder.setbeeactivitySensor(beeactivitySensor);
  encoder.sethoney(honey);
  encoder.composePayloadMain();

  ttn.sendBytes(encoder.getPayload(), static_cast<size_t>(encoder.getPayloadSize()), 1, false); // Unconfirmed on port 1.
}

void sendAlarmMessage(void)
{
  myPayloadEncoder encoder;
  uint8_t payloadIdentifier = 2;
  //int32_t latitude = 5198913943944424;
  //int32_t longitude = 5949173200069877;
  int32_t latitude = 5198913943;
  int32_t longitude = 5949173200;
  uint8_t position = 45;
  uint8_t beeAlarm = 1;
  
  encoder.setPayloadIdentifier(payloadIdentifier);
  encoder.setLatitude(latitude);
  encoder.setLongitude(longitude);
  encoder.setPosition(position);
  encoder.setbeeAlarm(beeAlarm);
  encoder.composePayloadGPS();

  ttn.sendBytes(encoder.getPayload(), static_cast<size_t>(encoder.getPayloadSize()), 2, false); // Unconfirmed on port 1. 
}

int amountHoney(void)
{
  honey += 1;
  if(honey == 13)
  {
    honey = 0; 
  }
  
  return honey;
}


/// \brief present "knightrider" on leds
void helloWorld(void)
{
  leftRedLED.setState(LED_ON);
  delay(100);
  leftRedLED.setState(LED_OFF);
  leftGreenLED.setState(LED_ON);
  delay(100);
  leftGreenLED.setState(LED_OFF);
  rightRedLED.setState(LED_ON);
  delay(100);
  rightRedLED.setState(LED_OFF);
  rightGreenLED.setState(LED_ON);
  delay(100);
  rightGreenLED.setState(LED_OFF);
  rightGreenLED.setState(LED_ON);
  delay(100);
  rightGreenLED.setState(LED_OFF);
  rightRedLED.setState(LED_ON);
  delay(100);
  rightRedLED.setState(LED_OFF);
  leftGreenLED.setState(LED_ON);
  delay(100);
  leftGreenLED.setState(LED_OFF);
  leftRedLED.setState(LED_ON);
  delay(100);
  leftRedLED.setState(LED_OFF);
}
